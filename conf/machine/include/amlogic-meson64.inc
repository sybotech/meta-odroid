## conf/machine/include/amlogic-meson64.inc
```bitbake
# Amlogic Meson64 Configurations

SOC_FAMILY = "amlogic:meson-gx"
require conf/machine/include/amlogic-meson.inc
require conf/machine/include/arm/arch-armv8.inc
```

## conf/machine/include/odroid-xu-default.inc
```bitbake
# Odroid XU default BSP

include conf/machine/include/samsung-exynos.inc
include conf/machine/include/odroid-default-settings.inc

DEFAULTTUNE = "cortexa15hf-neon"
include conf/machine/include/tune-cortexa15.inc

EXTRA_IMAGEDEPENDS += "secure-odroid"

UBOOT_FDT_LOADADDR = "0x40800000"
UBOOT_LOADADDR = "0x40007FC0"
UBOOT_LOADADDRESS = "0x40007FC0"
UBOOT_CONSOLE = "console=ttySAC2,115200"
UBOOT_KERNEL_NAME = "zimage"

WKS_FILE ?= "odroid_xu-u-boot.wks"

IMAGE_FSTYPES_append = " wic wic.xz"

# Do not update fstab file when using wic images
WIC_CREATE_EXTRA_ARGS ?= "--no-fstab-update"

IMAGE_BOOT_FILES = "zImage ${UBOOT_SCRIPT} ${KERNEL_DEVICETREE}"

# wic default support
WKS_FILE_DEPENDS ?= " \
    e2fsprogs-native \
    bmap-tools-native \
"
```

## conf/machine/odroid-c1.conf
```bitbake
#@TYPE: Machine
#@NAME: ODROID-C1
#@DESCRIPTION: Machine configuration for the ODROID-C1 by Hardkernel

DEFAULTTUNE ?= "cortexa5hf-neon"
require conf/machine/include/tune-cortexa5.inc

#TARGET_ARCH = "arm"

MACHINE_ESSENTIAL_EXTRA_RRECOMMENDS += " \
        kernel-image \
        kernel-devicetree \
        "

MACHINE_EXTRA_RRECOMMENDS += " \
        kernel-modules \
        "

PREFERRED_PROVIDER_virtual/kernel ?= "linux-stable"
PREFERRED_VERSION_linux-stable ?= "4.4%"

#specify u-boot parameters
PREFERRED_PROVIDER_virtual/bootloader ?= "u-boot"
PREFERRED_PROVIDER_u-boot ?= "u-boot"
PREFERRED_VERSION_u-boot ?= "v2016.03%"

UBOOT_MACHINE_odroid-c1 = "odroidc_config"

#KERNEL_DEVICETREE_odroid-c1 = "meson8b_odroidc.dtb"

#KERNEL_IMAGETYPE = "uImage"
KERNEL_IMAGETYPE = "zImage"
IMAGE_CLASSES += "odroidc-sdimg"
# ${SDIMG_ROOTFS_TYPE} is workaround, otherwise system mkfs.extX is used
# (e2fsprogs-native aren't built automatically). Native e2fsprogs should be
# built automatically because of IMAGE_TYPEDEP specified in odroidc-sdimg class.
IMAGE_FSTYPES += "tar.gz odroidc-sdimg ${SDIMG_ROOTFS_TYPE}"

SERIAL_CONSOLE = "115200 ttyS0"
```

## conf/machine/odroid-c2.conf
```bitbake
#@TYPE: Machine
#@NAME: odroid-c2
#@DESCRIPTION: Machine configuration for odroid-c2 systems
#@MAINTAINER: Armin Kuster <akuster808@gmail.com>

require conf/machine/include/amlogic-meson.inc

DEFAULTTUNE ?= "aarch64"
require conf/machine/include/arm/arch-armv8.inc
include conf/machine/include/odroid-default-settings.inc

EXTRA_IMAGEDEPENDS += "u-boot secure-odroid-c2"

MACHINE_FEATURES_BACKFILL_CONSIDERED = "rtc"

KERNEL_DEVICETREE_FN ?= "meson-gxbb-odroidc2.dtb"
KERNEL_DEVICETREE ?= "amlogic/meson-gxbb-odroidc2.dtb"

#specify u-boot parameters
UBOOT_MACHINE_odroid-c2 = "odroid-c2_defconfig"

KERNEL_IMAGETYPE = "Image"

UBOOT_LOADADDR ?= "0x01080000"
UBOOT_FDT_LOADADDR ?= "0x01000000"
UB_LOAD_CMD ?= "fatload"
UBOOT_BOOT_CMD ?= "booti"
UBOOT_KENREL_NAME ?= "uimage"

UBOOT_BIN_POS ?= "97"
UBOOT_ENV_POS ?= "1440"
UBOOT_SCRIPT = "boot.scr"
IMAGE_ROOTFS_ALIGNMENT = "1024"

IMAGE_CLASSES += "image_types_odroid"
```

## conf/machine/odroid-xu3.conf
```bitbake
#@TYPE: Machine
#@NAME: odroid-xu3
#@DESCRIPTION: Machine configuration for odroid-xu3 systems
#@MAINTAINER: Armin Kuster <akuster808@gmail.com>


include conf/machine/include/odroid-xu-default.inc

KERNEL_DEVICETREE ?= "exynos5422-odroidxu3.dtb"
UBOOT_MACHINE_odroid-xu3 = "odroid-xu3_defconfig"

PREFERRED_PROVIDER_virtual/egl = "mali-t62x"
PREFERRED_PROVIDER_virtual/libgles1 = "mali-t62x"
PREFERRED_PROVIDER_virtual/libgles2 = "mali-t62x"
PREFERRED_PROVIDER_virtual/libopencl = "mali-t62x"
PREFERRED_PROVIDER_virtual/libgl = "mesa"
PREFERRED_PROVIDER_virtual/mesa = "mesa"
```
